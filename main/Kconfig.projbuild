## main/Kconfig.projbuild
```kconfig
menu "Application Configuration"

	menu "WiFi Setting"

		config ESP_WIFI_SSID
			string "WiFi SSID"
			default "myssid"
			help
				SSID (network name) to connect to.

		config ESP_WIFI_PASSWORD
			string "WiFi Password"
			default "mypassword"
			help
				WiFi password (WPA or WPA2) to connect to.

	config ESP_MAXIMUM_RETRY
			int "Maximum retry"
			default 5
			help
				Set the Maximum retry to avoid station reconnecting to the AP unlimited when the AP is really inexistent.

	endmenu

	menu "VS1053 Setting"

		config GPIO_CS
			int "CS GPIO number"
			range 1 34
			default 5
			help
				GPIO number (IOxx) to SPI CS.
				Some GPIOs are used for other purposes (flash connections, etc.) and cannot be used to CS.
				GPIOs 35-39 are input-only so cannot be used as outputs.

		config GPIO_DCS
			int "DCS GPIO number"
			range 1 34
			default 16
			help
				GPIO number (IOxx) to SPI DCS.
				Some GPIOs are used for other purposes (flash connections, etc.) and cannot be used to DCS.
				GPIOs 35-39 are input-only so cannot be used as outputs.

		config GPIO_DREQ
			int "DREQ GPIO number"
			range 1 39
			default 4
			help
				GPIO number (IOxx) to SPI DREQ.
				Some GPIOs are used for other purposes (flash connections, etc.) and cannot be used to DREQ.
				GPIOs 35-39 are input-only so cannot be used as outputs.

		config GPIO_RESET
			int "RESET GPIO number"
			range -1 39
			default -1
			help
				GPIO number (IOxx) to RESET.
				-1 to use the hardware EN pin.
				Some GPIOs are used for other purposes (flash connections, etc.) and cannot be used to DREQ.
				GPIOs 35-39 are input-only so cannot be used as outputs.

		config VOLUME
			int "VS1053 Volume"
			range 50 100
			default 90
			help
				Volume value of VS1053.

	endmenu

	menu "RADIO Setting"

		config SERVER_HOST
			string "Hostname of radio station"
			default "ice2.somafm.com"
			help
				Hostname of radio station.

		config SERVER_PORT
			int "Port number of radio station"
			default 80
			help
				Port number of radio station.

		config SERVER_PATH
			string "Path of radio station"
			default "/seventies-128-mp3"
			help
				Path of radio station.

		choice METADATA_OUTPUT
			prompt "Metadata output destination"
			default METADATA_CONSOLE
			help
				Choose the Metadata output destination.

			config METADATA_NONE
				bool "Metadata is not output anywhere"
				help
					Metadata is not output anywhere.

			config METADATA_CONSOLE
				bool "Metadata is output to the console"
				help
					Metadata is output to the console.

			config METADATA_BROADCAST
				bool "Metadata is output to the UDP Broadcast"
				help
					Metadata is output to the UDP Broadcast.

			config METADATA_BOTH
				bool "Metadata is output to the console & UDP Broadcast"
				help
					Metadata is output to the console & UDP Broadcast.

		endchoice

		config UDP_PORT
			depends on METADATA_BROADCAST || METADATA_BOTH
			int "Port number to UDP broadcast"
			default 9876
			help
				Port number of UDP Broadcast.

	endmenu

endmenu
```
